## conf/layer.conf
```bitbake
BBPATH .= ":${LAYERDIR}"

LAYERDEPENDS_qti-display    = "core \
                               qti-bsp"
LAYERVERSION_qti-display    = "1"
BBFILE_COLLECTIONS         += "qti-display"
BBFILE_PRIORITY_qti-display = "12"
BBFILE_PATTERN_qti-display := "^${LAYERDIR}/"

LAYERSERIES_COMPAT_qti-display += "dunfell kirkstone"

BBFILES += "${LAYERDIR}/recipes/*/*.bb \
            ${LAYERDIR}/recipes/*/*.bbappend"
```
